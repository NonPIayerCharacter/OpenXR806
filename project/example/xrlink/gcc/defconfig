## project/test/etf/gcc/defconfig
```kconfig
CONFIG_PROJECT="test/etf"
CONFIG_XIP=y
CONFIG_WLAN=y
CONFIG_BLE_FEATURE=y
CONFIG_BLE=y
# CONFIG_BT is not set
# CONFIG_OTA is not set
# CONFIG_WIFI_CERTIFIED is not set
# CONFIG_WLAN_STA is not set
# CONFIG_WLAN_MONITOR is not set
# CONFIG_WLAN_AP is not set
CONFIG_ETF_CLI=y
CONFIG_ETF=y
CONFIG_PM=y
CONFIG_PM_WAKELOCKS=y
CONFIG_PM_TRY_NUM_WHEN_FAIL=0
CONFIG_STANDBY_RET_SRAM=y
CONFIG_STANDBY_RET_SRAM_ALL=y
# CONFIG_HIBERNATION_RET_SRAM is not set
# CONFIG_WAKEUP_PIN is not set
# CONFIG_BLE_LOW_PWR_MODE is not set
CONFIG_PM_DEBUG_LEVEL=4
```
